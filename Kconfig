## Kconfig
```kconfig
# SPDX-License-Identifier: Apache-2.0

menu "Deveritec Boards"

config DEVERITEC_BOARDS
    bool "Deveritec Boards"
    default y
    help
      Enable the Deveritec Boards.

endmenu
```

## boards/deveritec/dectnrpi_nds/Kconfig.dectnrpi_nds
```kconfig
# Copyright (c) 2026 Deveritec GmbH
# SPDX-License-Identifier: Apache-2.0

config BOARD_DECTNRPI_NDS
	select SOC_NRF9151_LACA
```

## boards/deveritec/dectnrpi_nds/Kconfig.defconfig
```kconfig
# Copyright (c) 2026 Deveritec GmbH
# SPDX-License-Identifier: Apache-2.0

if BOARD_DECTNRPI_NDS_NRF9151 || BOARD_DECTNRPI_NDS_NRF9151_NS

config BOARD_DECTNRPI_NDS
	select USE_DT_CODE_PARTITION if BOARD_DECTNRPI_NDS_NRF9151_NS

endif # BOARD_DECTNRPI_NDS_NRF9151 || BOARD_DECTNRPI_NDS_NRF9151_NS
```

## boards/deveritec/dectnrpi_nds/board.yml
```yaml
# Copyright (c) 2026 Deveritec GmbH
# SPDX-License-Identifier: Apache-2.0

board:
  name: dectnrpi_nds
  full_name: dectnrpi_nds
  vendor: deveritec
  socs:
  - name: nrf9151
    variants:
    - name: ns
```
